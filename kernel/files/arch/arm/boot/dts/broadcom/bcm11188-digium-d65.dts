// SPDX-License-Identifier: (GPL-2.0-only OR MIT)
/*
 * Digium/Sangoma D65 (BCM11188, 256 MiB RAM, SLC NAND, 480x272 color
 * display).
 */

/dts-v1/;

#include "bcm11188.dtsi"
#include "bcmring-digium-common.dtsi"
#include "bcmring-digium-d6x.dtsi"
#include "bcmring-digium-d65-bluetooth.dtsi"

/ {
	model = "Digium D65";
	compatible = "digium,d65", "brcm,bcm11188", "brcm,bcm11107";

	/*
	 * 256 MiB of DDR at 0.  The vendor 3.4 kernels keep the first 4 MiB
	 * away from Linux (CONFIG_BCM_RAM_START_RESERVED_SIZE=0x400000, kernel
	 * at 0x00408000; boot2 itself runs at 0x4000).
	 */
	memory@400000 {
		device_type = "memory";
		reg = <0x00400000 0x0fc00000>;
	};
};
