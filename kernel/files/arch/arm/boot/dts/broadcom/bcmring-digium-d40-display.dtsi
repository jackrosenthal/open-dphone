// SPDX-License-Identifier: (GPL-2.0-only OR MIT)
/*
 * The display of the Digium/Sangoma D40, D45, and D50: one 240x120
 * grayscale SPI panel.  Runs on a D40.  The three vendor kernels carry
 * identical display driver code, tables, and board data.
 *
 * Requires bcmring-digium-gray.dtsi.
 */

&spi0 {
	display@0 {
		compatible = "digium,d40-lcd";
		reg = <0>;
		/*
		 * Vendor board data: 10 MHz, mode 0.  With a 50 MHz SSP
		 * clock the PL022 divider yields 8.33 MHz.
		 */
		spi-max-frequency = <10000000>;
		/*
		 * Polling transfers.  In interrupt mode the PL022 takes an
		 * interrupt for every eleven bytes or so, back to back for
		 * the length of a frame (about 860 for the 9,600 bytes of
		 * the 240x120 panel), which starved the audio thread for
		 * longer than its playback queue lasts at every repaint.
		 * The driver sends the frame in pieces of about 1 ms.
		 */
		pl022,com-mode = <1>;
		dc-gpios = <&gpio0 22 GPIO_ACTIVE_HIGH>;
		reset-gpios = <&gpio1 10 GPIO_ACTIVE_LOW>;	/* GPIO 42 */
		backlight = <&backlight>;
	};
};

&backlight {
	/* Vendor probe default: level 7 of 31. */
	default-brightness = <7>;
};
