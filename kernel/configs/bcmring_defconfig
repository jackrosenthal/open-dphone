## kernel/files/Documentation/devicetree/bindings/remoteproc/brcm,bcmring-vpm.yaml
```yaml
# SPDX-License-Identifier: (GPL-2.0-only OR BSD-2-Clause)
%YAML 1.2
---
$id: http://devicetree.org/schemas/remoteproc/brcm,bcmring-vpm.yaml#
$schema: http://devicetree.org/meta-schemas/core.yaml#

title: Broadcom BCMRING (BCM11107 family) voice DSP ("VPM")

description: |
  A CEVA TeakLite-III core inside the BCM11107 family SoCs (BCM11109,
  BCM11170, BCM11188, BCM11189).  It is a compute coprocessor: the host
  sends it synchronous jobs (voice codecs, echo cancellation, band
  splitting) through a mailbox and four rings in a RAM shared with the ARM,
  with one interrupt in each direction.  It owns no audio hardware.

  The core has a small on-chip program RAM and data RAM and runs the bulk of
  its firmware from the lowest megabytes of DDR, which must not be part of
  the memory given to the operating system.

  The compatible selects the firmware generation: the BCM11109 and BCM11170
  use one image, ring size, and channel count, the BCM11188 and BCM11189
  another.

  The firmware programs channel 0 of the first DMA controller by itself.
  The dmas entry names that channel so that the operating system keeps the
  controller enabled and gives the channel to nobody else; no transfer is
  requested through it.

properties:
  compatible:
    enum:
      - brcm,bcm11109-vpm
      - brcm,bcm11170-vpm
      - brcm,bcm11188-vpm
      - brcm,bcm11189-vpm

  reg:
    items:
      - description: DSP program RAM
      - description: DSP data RAM
      - description: RAM shared between the DSP and the ARM (mailbox, rings)
      - description: DSP control block ("VINTC"), host-to-DSP interrupt and
          halt control

  reg-names:
    items:
      - const: pram
      - const: dram
      - const: vram
      - const: vintc

  interrupts:
    maxItems: 1
    description: DSP-to-host interrupt

  clocks:
    items:
      - description: bus-interface gate of the shared RAM

  clock-names:
    items:
      - const: vram

  dmas:
    maxItems: 1
    description: the DMA channel the DSP firmware drives by itself

  dma-names:
    items:
      - const: vpm

  memory-region:
    maxItems: 1
    description: the low DDR range the DSP executes from (no-map)

  firmware-name:
    maxItems: 1
    description: firmware file; the vendor's name is dspapp1107_lcc.bin

  brcm,chipc:
    $ref: /schemas/types.yaml#/definitions/phandle
    description:
      Chip-control block.  The DSP clock enable with its phase-alignment
      controls and the DSP reset-and-hold bits live there and have to be
      driven in a fixed sequence.

required:
  - compatible
  - reg
  - reg-names
  - interrupts
  - clocks
  - clock-names
  - memory-region
  - brcm,chipc

additionalProperties: false

examples:
  - |
    #include <dt-bindings/clock/brcm,bcmring-chipc.h>

    reserved-memory {
        #address-cells = <1>;
        #size-cells = <1>;
        ranges;

        vpm_ddr: vpm@0 {
            reg = <0x00000000 0x400000>;
            no-map;
        };
    };

    dsp@30800000 {
        compatible = "brcm,bcm11189-vpm";
        reg = <0x30800000 0x2000>, <0x30a00000 0x10000>,
              <0x40000000 0x10000>, <0x80003000 0x20>;
        reg-names = "pram", "dram", "vram", "vintc";
        interrupts = <16>;
        clocks = <&chipc BCMRING_CLK_BUSIF_VRAM>;
        clock-names = "vram";
        dmas = <&dma0 0 0 1 0x01>;
        dma-names = "vpm";
        memory-region = <&vpm_ddr>;
        brcm,chipc = <&chipc>;
        firmware-name = "dspapp1107_lcc.bin";
    };
```

## kernel/files/Documentation/devicetree/bindings/sound/brcm,bcm11107-apm.yaml
```yaml
# SPDX-License-Identifier: (GPL-2.0-only OR BSD-2-Clause)
# SKETCH -- not validated with dt-schema, not submitted anywhere.
%YAML 1.2
---
$id: http://devicetree.org/schemas/sound/brcm,bcm11107-apm.yaml#
$schema: http://devicetree.org/meta-schemas/core.yaml#

title: Broadcom BCMRING (BCM11107 family) APM analog audio front end

description: |
  On-chip voice codec of the BCM11107 family (BCM11109, BCM11170, BCM11188,
  BCM11189).  Two full-duplex mono channels; each has an ADC with a two-way
  microphone selector (A/B) and a DAC with two output drivers (A/B).  16-bit
  samples move through four FIFOs serviced by the SoC DesignWare DMA
  controller.

  DAI 0 is channel 0, DAI 1 is channel 1.  Pin widgets exposed for
  audio-routing: "CH0 MIC A", "CH0 MIC B", "CH1 MIC A", "CH1 MIC B",
  "CH0 OUT A", "CH0 OUT B", "CH1 OUT A", "CH1 OUT B", and the supplies
  "CH0 MICBIAS", "CH1 MICBIAS".

  Each channel's microphone selector follows the routing: input B is
  selected while a live microphone is routed to the channel's "MIC B" pin,
  input A otherwise.

  Which transducer hangs off which pin is board wiring and belongs in the
  sound card node (e.g., digium,bcmring-phone-audio), not here.

properties:
  compatible:
    items:
      - enum:
          - brcm,bcm11109-apm
          - brcm,bcm11170-apm
          - brcm,bcm11188-apm
          - brcm,bcm11189-apm
      - const: brcm,bcm11107-apm

  reg:
    items:
      - description: control registers (0x600 bytes; the SoC PCM/TDM block
          follows directly at +0x600 and is a separate device)
      - description: channel 0 capture FIFO
      - description: channel 0 playback FIFO
      - description: channel 1 capture FIFO
      - description: channel 1 playback FIFO

  reg-names:
    items:
      - const: core
      - const: rx0
      - const: tx0
      - const: rx1
      - const: tx1

  interrupts:
    maxItems: 1

  clocks:
    items:
      - description: 100 MHz block clock (vendor name APM100)
      - description: its 200 MHz parent (vendor name APM200), optional

    minItems: 1

  clock-names:
    items:
      - const: apm100
      - const: apm200
    minItems: 1

  dmas:
    maxItems: 4

  dma-names:
    items:
      - const: rx0
      - const: tx0
      - const: rx1
      - const: tx1

  resets:
    items:
      - description: APM block reset
      - description: second APM reset bit (the vendor releases both together)

  brcm,chipc:
    $ref: /schemas/types.yaml#/definitions/phandle
    description:
      Chip-control node.  The driver sets the audio clock/channel enables
      (offset 0x7c), which have no clock or reset abstraction, through its
      regmap.

  "#sound-dai-cells":
    const: 1

required:
  - compatible
  - reg
  - reg-names
  - interrupts
  - clocks
  - clock-names
  - dmas
  - dma-names
  - "#sound-dai-cells"

allOf:
  - $ref: dai-common.yaml#

unevaluatedProperties: false

examples:
  - |
    #include <dt-bindings/clock/brcm,bcmring-chipc.h>

    apm: audio-codec@30600000 {
        compatible = "brcm,bcm11189-apm", "brcm,bcm11107-apm";
        reg = <0x30600000 0x600>,
              <0x30670000 0x4>, <0x30680000 0x4>,
              <0x30690000 0x4>, <0x306a0000 0x4>;
        reg-names = "core", "rx0", "tx0", "rx1", "tx1";
        interrupts = <28>;
        clocks = <&chipc BCMRING_CLK_APM100>, <&chipc BCMRING_CLK_APM>;
        clock-names = "apm100", "apm200";
        /* request line, memory master, peripheral master, channel mask */
        dmas = <&dma0 2 0 1 0x08>, <&dma0 3 0 1 0x04>,
               <&dma0 4 0 1 0x20>, <&dma0 5 0 1 0x10>;
        dma-names = "rx0", "tx0", "rx1", "tx1";
        resets = <&chipc BCMRING_RST_APM>, <&chipc BCMRING_RST_APM2>;
        brcm,chipc = <&chipc>;
        #sound-dai-cells = <1>;
    };
```

## kernel/files/Documentation/devicetree/bindings/sound/brcm,bcm11107-pcm.yaml
```yaml
# SPDX-License-Identifier: (GPL-2.0-only OR BSD-2-Clause)
%YAML 1.2
---
$id: http://devicetree.org/schemas/sound/brcm,bcm11107-pcm.yaml#
$schema: http://devicetree.org/meta-schemas/core.yaml#

title: Broadcom BCMRING (BCM11107 family) PCM/TDM interface

description: |
  Serial PCM/TDM interface of the BCM11107 family (BCM11109, BCM11170,
  BCM11188, BCM11189), in the register window of the APM audio front end.
  The SoC drives the bit clock (1.024 MHz) and the frame sync (8 or 16 kHz);
  one 16-bit channel in time slot 0 is exposed as a mono DAI.  Samples move
  through two FIFOs serviced by the SoC DesignWare DMA controller.

maintainers:
  - Open Desk Phone contributors

allOf:
  - $ref: dai-common.yaml#

properties:
  compatible:
    items:
      - enum:
          - brcm,bcm11109-pcm
          - brcm,bcm11170-pcm
          - brcm,bcm11188-pcm
          - brcm,bcm11189-pcm
      - const: brcm,bcm11107-pcm

  reg:
    items:
      - description: control registers
      - description: receive FIFO
      - description: transmit FIFO

  reg-names:
    items:
      - const: core
      - const: rx
      - const: tx

  clocks:
    items:
      - description: 100 MHz audio clock
      - description: its 200 MHz parent

  clock-names:
    items:
      - const: apm100
      - const: apm200

  resets:
    maxItems: 1

  dmas:
    items:
      - description: receive
      - description: transmit

  dma-names:
    items:
      - const: rx
      - const: tx

  brcm,chipc:
    $ref: /schemas/types.yaml#/definitions/phandle
    description: chip-control syscon holding the audio clock enables

  "#sound-dai-cells":
    const: 0

required:
  - compatible
  - reg
  - reg-names
  - clocks
  - clock-names
  - resets
  - dmas
  - dma-names
  - brcm,chipc
  - "#sound-dai-cells"

unevaluatedProperties: false

examples:
  - |
    pcm@30600600 {
        compatible = "brcm,bcm11188-pcm", "brcm,bcm11107-pcm";
        reg = <0x30600600 0x100>, <0x306c0000 0x4>, <0x306d0000 0x4>;
        reg-names = "core", "rx", "tx";
        clocks = <&chipc 15>, <&chipc 20>;
        clock-names = "apm100", "apm200";
        resets = <&chipc 33>;
        dmas = <&dma0 12 0 1 0x02>, <&dma0 13 0 1 0x40>;
        dma-names = "rx", "tx";
        brcm,chipc = <&chipc>;
        #sound-dai-cells = <0>;
    };
```

## kernel/files/Documentation/devicetree/bindings/sound/digium,bcmring-phone-audio.yaml
```yaml
# SPDX-License-Identifier: (GPL-2.0-only OR BSD-2-Clause)
%YAML 1.2
---
$id: http://devicetree.org/schemas/sound/digium,bcmring-phone-audio.yaml#
$schema: http://devicetree.org/meta-schemas/core.yaml#

title: Digium/Sangoma D-series desk phone sound card

description: |
  Sound card of the D40, D45, D50, D60, D62, D65, and D70 phones.  The
  converters are the two channels of the on-chip BCMRING APM
  (brcm,bcm11107-apm); there is no external codec.  The card has three PCM
  devices: 0 speakerphone (APM channel 1), 1 handset (APM channel 0), and 2
  headset (APM channel 1).

  The card defines the board widgets "Speakerphone Mic", "Loudspeaker",
  "Handset Mic", "Handset Receiver", "Headset Mic", and "Headset Receiver",
  and connects only the pair that belongs to an open PCM device.
  audio-routing connects them to the APM pins ("CH0 MIC A", "CH0 MIC B",
  "CH1 MIC A", "CH1 MIC B", "CH0 OUT A", "CH0 OUT B", "CH1 OUT A",
  "CH1 OUT B", and the supplies "CH0 MICBIAS", "CH1 MICBIAS") and to the
  widgets of the auxiliary devices.  APM pins that are not routed are
  treated as not connected.

allOf:
  - $ref: sound-card-common.yaml#

properties:
  compatible:
    const: digium,bcmring-phone-audio

  audio-cpu:
    $ref: /schemas/types.yaml#/definitions/phandle
    description: The APM node.

  aux-devs:
    $ref: /schemas/types.yaml#/definitions/phandle-array
    description: The speaker amplifier (simple-audio-amplifier).

  speaker-select-gpios:
    maxItems: 1
    description:
      D40 and D50 only, where the headset and the speakerphone use the same
      APM microphone input and output driver.  Driven active while the
      speakerphone PCM device is in use and inactive while the headset PCM
      device is in use; left unchanged for the handset.  The stock firmware
      drives the line this way; its electrical function (analog switch,
      mute, or amplifier enable) is inferred, not known.

required:
  - compatible
  - model
  - audio-routing
  - audio-cpu

unevaluatedProperties: false

examples:
  - |
    sound {
        compatible = "digium,bcmring-phone-audio";
        model = "Digium Phone";
        audio-cpu = <&apm>;
        aux-devs = <&speaker_amp>;
        audio-routing =
            "CH0 MIC A", "Handset Mic",
            "Handset Mic", "CH0 MICBIAS",
            "Handset Receiver", "CH0 OUT A",
            "CH1 MIC A", "Speakerphone Mic",
            "Speakerphone Mic", "CH1 MICBIAS",
            "Speaker Amp INL", "CH1 OUT A",
            "Loudspeaker", "Speaker Amp OUTL",
            "CH1 MIC B", "Headset Mic",
            "Headset Mic", "CH1 MICBIAS",
            "Headset Receiver", "CH1 OUT B";
    };
```

## kernel/files/arch/arm/mach-bcmring/Kconfig
```kconfig
# SPDX-License-Identifier: GPL-2.0-only
config ARCH_BCMRING
	bool "Broadcom BCMRING (BCM11107 family) SoC support"
	depends on ARCH_MULTI_V6
	select ARM_AMBA
	select ARM_VIC
	select ARM_TIMER_SP804
	select COMMON_CLK_BCMRING
	select GPIOLIB
	select MFD_SYSCON
	select PINCTRL
	select PINCTRL_SINGLE
	select RESET_CONTROLLER
	help
	  Support for the Broadcom BCMRING ARM1176JZ-S SoCs (BCM11107,
	  BCM11109, BCM11170, BCM11188, BCM11189, ...) as found in the
	  Digium/Sangoma D40, D45, D50, D60, D62, D65, and D70 desk phones.
```
