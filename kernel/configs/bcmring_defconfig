## kernel/files/Documentation/devicetree/bindings/leds/backlight/brcm,bcmring-backlight.yaml
```yaml
# SPDX-License-Identifier: (GPL-2.0-only OR BSD-2-Clause)
%YAML 1.2
---
$id: http://devicetree.org/schemas/leds/backlight/brcm,bcmring-backlight.yaml#
$schema: http://devicetree.org/meta-schemas/core.yaml#

title: Broadcom BCMRING PWM backlight

description:
  The BCMRING SoCs (BCM11107 family, including BCM11188 and BCM11189) have
  a one-register PWM block with a 5-bit duty cycle and four selectable
  frequencies (about 48, 97, 195, and 390 Hz).  Boards use it to dim the
  LCD backlight.  Because the duty field tops out at 31/32, fully on and
  fully off are produced by switching the output pad to its GPIO function
  and driving it.  Level 0 drives the pad low, levels from
  brcm,full-on-level up to max-brightness drive it high, and the levels in
  between are PWM duty steps.  The register directly follows the LED matrix
  controller (brcm,bcmring-ledm) and shares its clocks.

allOf:
  - $ref: common.yaml#

properties:
  compatible:
    const: brcm,bcmring-backlight

  reg:
    maxItems: 1

  clocks:
    items:
      - description: PWM modulator clock (vendor name LED_PWM)
      - description: register interface gate (shared with the LED matrix)

  clock-names:
    items:
      - const: pwm
      - const: bus

  gpios:
    maxItems: 1
    description:
      The PWM output pad in its GPIO function, driven high for brightness
      32 and low for brightness 0.

  pinctrl-names:
    items:
      - const: default
      - const: gpio

  pinctrl-0:
    description: Pad carries the PWM output (brightness 1 to 31).

  pinctrl-1:
    description: Pad is a GPIO (brightness 0 and 32).

  brcm,pwm-frequency-hz:
    description: Requested PWM frequency; rounded down to a supported one.
    enum: [48, 97, 195, 390]
    default: 97

  default-brightness:
    maximum: 32

  max-brightness:
    description:
      Highest brightness level.  32 on the Digium D60/D62/D65 (the default),
      31 on the D40/D45/D50/D70.
    minimum: 2
    maximum: 32
    default: 32

  brcm,full-on-level:
    $ref: /schemas/types.yaml#/definitions/uint32
    description:
      Lowest level at which the pad is driven high as a GPIO instead of
      carrying the PWM output.  Defaults to max-brightness.  The Digium
      D40/D45/D50/D70 use 30 with max-brightness 31.
    minimum: 2
    maximum: 32

required:
  - compatible
  - reg

unevaluatedProperties: false

examples:
  - |
    #include <dt-bindings/clock/brcm,bcmring-chipc.h>

    backlight@80002040 {
        compatible = "brcm,bcmring-backlight";
        reg = <0x80002040 0x4>;
        clocks = <&chipc BCMRING_CLK_LED>, <&chipc BCMRING_CLK_BUSIF_LED>;
        clock-names = "pwm", "bus";
        gpios = <&gpio1 3 0>;
        pinctrl-names = "default", "gpio";
        pinctrl-0 = <&backlight_pwm_pin>;
        pinctrl-1 = <&backlight_gpio_pin>;
        brcm,pwm-frequency-hz = <97>;
        max-brightness = <32>;
        default-brightness = <32>;
    };
...
```

## kernel/files/Documentation/devicetree/bindings/leds/brcm,bcmring-ledm.yaml
```yaml
# SPDX-License-Identifier: (GPL-2.0-only OR BSD-2-Clause)
# Binding draft.  Passes dt_binding_check apart from the missing "maintainers" entry.
%YAML 1.2
---
$id: http://devicetree.org/schemas/leds/brcm,bcmring-ledm.yaml#
$schema: http://devicetree.org/meta-schemas/core.yaml#

title: Broadcom BCMRING (BCM11107 family) LED matrix controller

description:
  Self-refreshing LED matrix controller ("LEDM"), at most 6 rows by 12
  columns, on/off per lamp.  Only the parallel mode used by the Digium
  boards is described; there row r is pad GPIO 16 + r and column c is pad
  GPIO c, both on mux function 5.  The names of the timing properties are
  the names the vendor driver prints; their units are not known.

properties:
  compatible:
    const: brcm,bcmring-ledm

  reg:
    maxItems: 1

  clocks:
    items:
      - description: LED bus-interface gate (chip control BusIntfClock bit 16)
      - description: LED clock (vendor "LED_PWM", chip control LEDClock)

  clock-names:
    items:
      - const: bus
      - const: led

  "#address-cells":
    const: 2

  "#size-cells":
    const: 0

  brcm,scan-rows:
    description: Number of matrix rows the controller scans.
    $ref: /schemas/types.yaml#/definitions/uint32
    minimum: 1
    maximum: 6
    default: 5

  brcm,scan-columns:
    description: Number of matrix columns the controller scans.
    $ref: /schemas/types.yaml#/definitions/uint32
    minimum: 1
    maximum: 12
    default: 8

  brcm,clk-div:
    description: Clock divider field of the control register (vendor name "clkdiv"); unit not known.
    $ref: /schemas/types.yaml#/definitions/uint32
    maximum: 3
    default: 2

  brcm,res-div:
    description: Resolution divider field (vendor name "resdiv"); unit not known.
    $ref: /schemas/types.yaml#/definitions/uint32
    maximum: 255
    default: 100

  brcm,on-time:
    description: Lamp on-time field (vendor name "ontime"); unit not known.
    $ref: /schemas/types.yaml#/definitions/uint32

  brcm,guard-time:
    description: Guard time between rows (vendor name "guardtime"); unit not known.
    $ref: /schemas/types.yaml#/definitions/uint32

patternProperties:
  "^led@[0-5],([0-9]|1[01])$":
    type: object
    $ref: common.yaml#
    unevaluatedProperties: false

    properties:
      reg:
        description: Hardware row and column, both counted from zero.
        maxItems: 1

    required:
      - reg

required:
  - compatible
  - reg
  - clocks
  - clock-names
  - "#address-cells"
  - "#size-cells"

additionalProperties: false

examples:
  - |
    #include <dt-bindings/leds/common.h>
    led-controller@80002000 {
        compatible = "brcm,bcmring-ledm";
        reg = <0x80002000 0x40>;
        clocks = <&chipc 48>, <&chipc 17>; /* BUSIF_LED, LED */
        clock-names = "bus", "led";
        #address-cells = <2>;
        #size-cells = <0>;
        brcm,on-time = <256>;
        brcm,guard-time = <100>;

        led@0,2 {
            reg = <0 2>;
            color = <LED_COLOR_ID_GREEN>;
            function = LED_FUNCTION_MAIL;
        };
    };
```

## kernel/files/Documentation/devicetree/bindings/mtd/brcm,bcmring-nand.yaml
```yaml
# SPDX-License-Identifier: (GPL-2.0-only OR BSD-2-Clause)
%YAML 1.2
---
$id: http://devicetree.org/schemas/mtd/brcm,bcmring-nand.yaml#
$schema: http://devicetree.org/meta-schemas/core.yaml#

title: Broadcom BCMRING UMI NAND controller

description:
  Single-chip-select raw NAND controller of the BCM11107 family (vendor
  driver name "bcm_umi-nand").  The ECC format is fixed by the boot ROM and
  boot loaders (BCH-8 over 512-byte steps, 13 ECC bytes per step at OOB
  offsets 16 * step + 3), so no nand-ecc-* properties are used.

allOf:
  - $ref: nand-controller.yaml#

properties:
  compatible:
    const: brcm,bcmring-nand

  reg:
    items:
      - description: UMI controller registers
      - description: NAND command, address, and data aperture

  interrupts:
    maxItems: 1

  clocks:
    maxItems: 1

required:
  - compatible
  - reg

unevaluatedProperties: false

examples:
  - |
    nand-controller@80001000 {
        compatible = "brcm,bcmring-nand";
        reg = <0x80001000 0x100>, <0x80001800 0x800>;
        #address-cells = <1>;
        #size-cells = <0>;

        nand@0 {
            reg = <0>;
            label = "bcm_umi-nand";
        };
    };
```

## kernel/files/Documentation/devicetree/bindings/net/brcm,bcmring-enet.yaml
```yaml
# SPDX-License-Identifier: (GPL-2.0-only OR BSD-2-Clause)
%YAML 1.2
---
$id: http://devicetree.org/schemas/net/brcm,bcmring-enet.yaml#
$schema: http://devicetree.org/meta-schemas/core.yaml#

title: Broadcom BCMRING embedded-switch CPU port

description: |
  The BCMRING SoCs (BCM11107/11109/11170/11188/11189 and relatives) embed a
  two-port plus IMP Broadcom ROBO switch.  The CPU reaches the IMP port
  through a pair of FIFOs that are filled and drained by two dedicated
  channels (2 and 3) of the SoC's second Synopsys DesignWare AHB DMA
  controller.  Frames carry the 4-byte Broadcom tag after the source MAC
  address, so this node is the conduit ("ethernet" phandle target) of the
  brcm,bcmring-switch DSA switch node, which uses the "brcm" tag protocol.

  The driver programs the two DMA channels itself because it needs
  DesignWare features the generic dmaengine driver does not offer
  (peripheral flow control with status write-back).  This node therefore
  owns the whole of DMA controller 1: its register block ("dmac"), its
  bus-interface clock gate, and the interrupt lines of channels 2 and 3.
  At probe the driver switches the controller on and disables, masks, and
  clears all eight channels; the controller's own snps,dma-spear1340 node
  must stay disabled, and its other six channels are unavailable.

allOf:
  - $ref: ethernet-controller.yaml#

properties:
  compatible:
    const: brcm,bcmring-enet

  reg:
    items:
      - description: Port FIFO bridge (Rx at 0x0, Tx at 0x10000)
      - description: DesignWare DMA controller 1 register block

  reg-names:
    items:
      - const: fifo
      - const: dmac

  interrupts:
    items:
      - description: DMA controller 1 channel 2 (Rx)
      - description: DMA controller 1 channel 3 (Tx)

  interrupt-names:
    items:
      - const: rx
      - const: tx

  clocks:
    items:
      - description: 100 MHz ESW clock (vendor chipc clock index 2)
      - description: bus-interface gate of the switch block
      - description: bus-interface gate of DMA controller 1

  clock-names:
    items:
      - const: esw
      - const: bus
      - const: dmac

required:
  - compatible
  - reg
  - reg-names
  - interrupts
  - interrupt-names
  - fixed-link

unevaluatedProperties: false

examples:
  - |
    #include <dt-bindings/clock/brcm,bcmring-chipc.h>

    /* vendor Linux IRQs 10 and 11 = inputs 10 and 11 of the first VIC */
    ethernet@30480000 {
        compatible = "brcm,bcmring-enet";
        reg = <0x30480000 0x20000>, <0x30300000 0x400>;
        reg-names = "fifo", "dmac";
        interrupts = <10>, <11>;
        interrupt-names = "rx", "tx";
        clocks = <&chipc BCMRING_CLK_ESW>,
                 <&chipc BCMRING_CLK_BUSIF_ESW>,
                 <&chipc BCMRING_CLK_BUSIF_DMAC1>;
        clock-names = "esw", "bus", "dmac";
        phy-mode = "internal";
        /*
         * No address source in hardware.  local-mac-address from a boot
         * loader is honored; otherwise userspace sets the address.
         */

        fixed-link {
            speed = <1000>;
            full-duplex;
        };
    };
```

## kernel/files/Documentation/devicetree/bindings/net/dsa/brcm,bcmring-switch.yaml
```yaml
# SPDX-License-Identifier: (GPL-2.0-only OR BSD-2-Clause)
# SKETCH ONLY: not validated with dt_binding_check, never tested on hardware.
%YAML 1.2
---
$id: http://devicetree.org/schemas/net/dsa/brcm,bcmring-switch.yaml#
$schema: http://devicetree.org/meta-schemas/core.yaml#

title: Broadcom BCMRING integrated Ethernet switch

description:
  Three-port (two integrated PHY ports plus an internal IMP port) Robo-style
  switch core found in BCM11107/BCM11109/BCM11170/BCM11188/BCM11189 SoCs.
  Registers are memory mapped with one 8 byte slot per (page, register).

allOf:
  - $ref: dsa.yaml#/$defs/ethernet-ports

properties:
  compatible:
    description:
      The SoC-specific entry tells the driver whether the two integrated
      PHYs may run 1000BASE-T (BCM11109, BCM11188) or only 10/100
      (BCM11170, BCM11189); the PHYs have no nodes that could carry
      max-speed.
    items:
      - enum:
          - brcm,bcm11109-switch
          - brcm,bcm11170-switch
          - brcm,bcm11188-switch
          - brcm,bcm11189-switch
      - const: brcm,bcmring-switch

  reg:
    items:
      - description: switch core, page/register slots (0x80000 bytes)
      - description:
          wrapper block (ready flag, PHY power-down, indirect MII accessor
          for the integrated PHYs, IMP speed).  Owned entirely by this node;
          the integrated PHYs appear on the DSA user MDIO bus with address
          equal to the port number.

  reg-names:
    items:
      - const: core
      - const: wrapper

  clocks:
    items:
      - description: switch core clock (vendor sets it to 100 MHz)
      - description: bus-interface gate of the switch block

  clock-names:
    items:
      - const: esw
      - const: bus

  resets:
    items:
      - description: switch clock reset
      - description: switch core reset

  reset-names:
    items:
      - const: clk
      - const: core

  brcm,chipc:
    $ref: /schemas/types.yaml#/definitions/phandle
    description:
      Chip-control node.  When present, register 0 is read before each
      switch register read, as the vendor driver does.  Single reads return
      correct values without it (measured under the vendor firmware), so it
      is expected to go away once that is confirmed for back-to-back reads.

required:
  - compatible
  - reg
  - reg-names

unevaluatedProperties: false

examples:
  - |
    #include <dt-bindings/clock/brcm,bcmring-chipc.h>

    ethernet-switch@30400000 {
        compatible = "brcm,bcm11189-switch", "brcm,bcmring-switch";
        reg = <0x30400000 0x80000>, <0x304a0000 0x100>;
        reg-names = "core", "wrapper";
        clocks = <&chipc BCMRING_CLK_ESW>, <&chipc BCMRING_CLK_BUSIF_ESW>;
        clock-names = "esw", "bus";
        resets = <&chipc BCMRING_RST_ESWCLK>, <&chipc BCMRING_RST_ESW>;
        reset-names = "clk", "core";
        brcm,chipc = <&chipc>;

        ethernet-ports {
            #address-cells = <1>;
            #size-cells = <0>;

            port@0 {
                reg = <0>;
                label = "lan";
                phy-mode = "internal";
            };

            port@1 {
                reg = <1>;
                label = "pc";
                phy-mode = "internal";
            };

            port@8 {
                reg = <8>;
                ethernet = <&enet>;
                phy-mode = "internal";

                fixed-link {
                    speed = <1000>;
                    full-duplex;
                };
            };
        };
    };
```
