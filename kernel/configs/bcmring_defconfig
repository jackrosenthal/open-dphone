## kernel/configs/bcmring_defconfig
```kconfig
# CONFIG_LOCALVERSION_AUTO is not set
CONFIG_KERNEL_XZ=y
CONFIG_SYSVIPC=y
CONFIG_NO_HZ_IDLE=y
CONFIG_HIGH_RES_TIMERS=y
CONFIG_LOG_BUF_SHIFT=16
CONFIG_CC_OPTIMIZE_FOR_SIZE=y
CONFIG_EXPERT=y
CONFIG_KEXEC=y
# CONFIG_CRASH_DUMP is not set
CONFIG_ARCH_MULTI_V6=y
# CONFIG_ARCH_MULTI_V7 is not set
CONFIG_ARCH_BCMRING=y
CONFIG_ARM_APPENDED_DTB=y
CONFIG_ARM_APPENDED_DTB_MEM_START=y
CONFIG_ARM_ATAG_DTB_COMPAT=y
CONFIG_ARM_ATAG_DTB_COMPAT_CMDLINE_EXTEND=y
# CONFIG_SUSPEND is not set
CONFIG_PM=y
CONFIG_MODULES=y
CONFIG_MODULE_UNLOAD=y
CONFIG_NET=y
CONFIG_PACKET=y
CONFIG_UNIX=y
CONFIG_INET=y
CONFIG_IP_MULTICAST=y
CONFIG_IP_PNP=y
CONFIG_IP_PNP_DHCP=y
CONFIG_BRIDGE=y
CONFIG_BRIDGE_VLAN_FILTERING=y
CONFIG_NET_DSA=y
CONFIG_VLAN_8021Q=y
CONFIG_DEVTMPFS=y
CONFIG_DEVTMPFS_MOUNT=y
CONFIG_MTD=y
CONFIG_MTD_CMDLINE_PARTS=y
CONFIG_MTD_BLOCK=y
CONFIG_MTD_PHRAM=y
CONFIG_MTD_RAW_NAND=y
CONFIG_MTD_NAND_BCMRING=y
CONFIG_MTD_UBI=m
CONFIG_NETDEVICES=y
CONFIG_B53=y
CONFIG_B53_BCMRING_DRIVER=y
CONFIG_BCMRING_ENET=y
CONFIG_BROADCOM_PHY=y
CONFIG_INPUT_EVDEV=y
CONFIG_KEYBOARD_GPIO=y
CONFIG_KEYBOARD_BCMRING=y
# CONFIG_INPUT_MOUSE is not set
CONFIG_SERIAL_AMBA_PL011=y
CONFIG_SERIAL_AMBA_PL011_CONSOLE=y
CONFIG_HW_RANDOM=y
CONFIG_SPI=y
CONFIG_SPI_PL022=y
CONFIG_GPIO_BCMRING=y
CONFIG_WATCHDOG=y
CONFIG_ARM_SP805_WATCHDOG=y
CONFIG_REGULATOR=y
CONFIG_REGULATOR_FIXED_VOLTAGE=y
CONFIG_DRM=y
CONFIG_DRM_FBDEV_EMULATION=y
CONFIG_DRM_PANEL_SIMPLE=y
CONFIG_DRM_PL111=y
CONFIG_DRM_DIGIUM_GRAY_LCD=y
CONFIG_LCD_CLASS_DEVICE=y
CONFIG_BACKLIGHT_BCMRING=y
CONFIG_SOUND=y
CONFIG_SND=y
CONFIG_SND_SOC=y
CONFIG_SND_SOC_BCMRING_APM=y
CONFIG_SND_SOC_BCMRING_DIGIUM=y
CONFIG_SND_SOC_SIMPLE_AMPLIFIER=y
# CONFIG_USB_SUPPORT is not set
CONFIG_NEW_LEDS=y
CONFIG_LEDS_CLASS=y
CONFIG_LEDS_BCMRING_LEDM=y
CONFIG_LEDS_TRIGGERS=y
CONFIG_LEDS_TRIGGER_TIMER=y
CONFIG_LEDS_TRIGGER_HEARTBEAT=m
CONFIG_DMADEVICES=y
CONFIG_DW_DMAC=y
CONFIG_REMOTEPROC=y
CONFIG_BCMRING_VPM_REMOTEPROC=m
CONFIG_TMPFS=y
CONFIG_JFFS2_FS=y
CONFIG_UBIFS_FS=m
CONFIG_PRINTK_TIME=y
CONFIG_MAGIC_SYSRQ=y
```

## kernel/configs/bcmring_tiny_defconfig
```kconfig
# CONFIG_LOCALVERSION_AUTO is not set
CONFIG_KERNEL_XZ=y
# CONFIG_CROSS_MEMORY_ATTACH is not set
CONFIG_HIGH_RES_TIMERS=y
CONFIG_LOG_BUF_SHIFT=14
CONFIG_CC_OPTIMIZE_FOR_SIZE=y
CONFIG_LD_DEAD_CODE_DATA_ELIMINATION=y
CONFIG_EXPERT=y
# CONFIG_UID16 is not set
# CONFIG_FHANDLE is not set
# CONFIG_AIO is not set
# CONFIG_IO_URING is not set
# CONFIG_ADVISE_SYSCALLS is not set
# CONFIG_MEMBARRIER is not set
# CONFIG_RSEQ is not set
# CONFIG_CACHESTAT_SYSCALL is not set
# CONFIG_KALLSYMS is not set
CONFIG_KEXEC=y
# CONFIG_CRASH_DUMP is not set
CONFIG_ARCH_MULTI_V6=y
# CONFIG_ARCH_MULTI_V7 is not set
CONFIG_ARCH_BCMRING=y
# CONFIG_CACHE_L2X0 is not set
CONFIG_ARM_APPENDED_DTB=y
CONFIG_ARM_APPENDED_DTB_MEM_START=y
CONFIG_ARM_ATAG_DTB_COMPAT=y
CONFIG_ARM_ATAG_DTB_COMPAT_CMDLINE_EXTEND=y
# CONFIG_SUSPEND is not set
CONFIG_PM=y
# CONFIG_SECCOMP is not set
# CONFIG_STACKPROTECTOR is not set
# CONFIG_GCC_PLUGINS is not set
CONFIG_MODULES=y
CONFIG_MODULE_UNLOAD=y
# CONFIG_MQ_IOSCHED_DEADLINE is not set
# CONFIG_MQ_IOSCHED_KYBER is not set
# CONFIG_COREDUMP is not set
# CONFIG_SWAP is not set
CONFIG_SLUB_TINY=y
# CONFIG_COMPAT_BRK is not set
# CONFIG_COMPACTION is not set
# CONFIG_VM_EVENT_COUNTERS is not set
CONFIG_NET=y
CONFIG_PACKET=y
CONFIG_UNIX=y
CONFIG_INET=y
CONFIG_IP_MULTICAST=y
# CONFIG_INET_DIAG is not set
# CONFIG_IPV6_SIT is not set
CONFIG_BRIDGE=y
# CONFIG_BRIDGE_IGMP_SNOOPING is not set
CONFIG_BRIDGE_VLAN_FILTERING=y
CONFIG_NET_DSA=y
CONFIG_VLAN_8021Q=y
# CONFIG_WIRELESS is not set
# CONFIG_ETHTOOL_NETLINK is not set
CONFIG_DEVTMPFS=y
CONFIG_DEVTMPFS_MOUNT=y
CONFIG_DRIVER_DEFERRED_PROBE_TIMEOUT=0
# CONFIG_STANDALONE is not set
# CONFIG_PREVENT_FIRMWARE_BUILD is not set
# CONFIG_ALLOW_DEV_COREDUMP is not set
CONFIG_MTD=y
CONFIG_MTD_CMDLINE_PARTS=y
CONFIG_MTD_BLOCK=y
CONFIG_MTD_PHRAM=y
CONFIG_MTD_RAW_NAND=y
CONFIG_MTD_NAND_BCMRING=y
CONFIG_NETDEVICES=y
CONFIG_B53=y
CONFIG_B53_BCMRING_DRIVER=y
# CONFIG_NET_VENDOR_ALACRITECH is not set
CONFIG_BCMRING_ENET=y
CONFIG_BROADCOM_PHY=y
# CONFIG_WLAN is not set
# CONFIG_INPUT_LEDS is not set
CONFIG_INPUT_EVDEV=y
# CONFIG_KEYBOARD_ATKBD is not set
CONFIG_KEYBOARD_GPIO=y
CONFIG_KEYBOARD_BCMRING=y
# CONFIG_INPUT_MOUSE is not set
# CONFIG_SERIO is not set
# CONFIG_VT is not set
# CONFIG_LEGACY_PTYS is not set
CONFIG_SERIAL_AMBA_PL011=y
CONFIG_SERIAL_AMBA_PL011_CONSOLE=y
CONFIG_HW_RANDOM=y
# CONFIG_DEVPORT is not set
CONFIG_SPI=y
CONFIG_SPI_PL022=m
# CONFIG_PTP_1588_CLOCK is not set
CONFIG_GPIO_BCMRING=y
# CONFIG_HWMON is not set
CONFIG_WATCHDOG=y
CONFIG_WATCHDOG_OPEN_TIMEOUT=120
CONFIG_ARM_SP805_WATCHDOG=y
CONFIG_REGULATOR=y
CONFIG_REGULATOR_FIXED_VOLTAGE=y
CONFIG_DRM=y
CONFIG_DRM_PANEL_SIMPLE=y
CONFIG_DRM_PL111=y
CONFIG_DRM_DIGIUM_GRAY_LCD=m
CONFIG_LCD_CLASS_DEVICE=m
CONFIG_BACKLIGHT_CLASS_DEVICE=y
CONFIG_BACKLIGHT_BCMRING=y
CONFIG_SOUND=m
CONFIG_SND=m
CONFIG_SND_SOC=m
CONFIG_SND_SOC_BCMRING_APM=m
CONFIG_SND_SOC_BCMRING_DIGIUM=m
CONFIG_SND_SOC_SIMPLE_AMPLIFIER=m
# CONFIG_HID_SUPPORT is not set
# CONFIG_USB_SUPPORT is not set
CONFIG_NEW_LEDS=y
CONFIG_LEDS_CLASS=y
CONFIG_LEDS_BCMRING_LEDM=y
CONFIG_DMADEVICES=y
CONFIG_DW_DMAC=m
# CONFIG_VIRTIO_MENU is not set
# CONFIG_VHOST_MENU is not set
CONFIG_REMOTEPROC=y
CONFIG_BCMRING_VPM_REMOTEPROC=m
# CONFIG_NVMEM is not set
# CONFIG_DNOTIFY is not set
# CONFIG_PROC_PAGE_MONITOR is not set
CONFIG_TMPFS=y
CONFIG_JFFS2_FS=y
CONFIG_PSTORE=y
# CONFIG_PSTORE_COMPRESS is not set
CONFIG_PSTORE_CONSOLE=y
CONFIG_PSTORE_RAM=y
# CONFIG_NETWORK_FILESYSTEMS is not set
# CONFIG_CRC_OPTIMIZATIONS is not set
# CONFIG_SYMBOLIC_ERRNAME is not set
# CONFIG_DEBUG_BUGVERBOSE is not set
# CONFIG_DEBUG_MISC is not set
# CONFIG_SECTION_MISMATCH_WARN_ONLY is not set
# CONFIG_RUNTIME_TESTING_MENU is not set
CONFIG_BT=m
CONFIG_BT_RFCOMM=m
# CONFIG_BT_LE is not set
CONFIG_BT_HCIUART=m
CONFIG_BT_HCIUART_BCM=y
CONFIG_SERIAL_DEV_BUS=y
CONFIG_SND_SOC_BCMRING_PCM=m
CONFIG_SND_SOC_BT_SCO=m
CONFIG_SND_SIMPLE_CARD=m
CONFIG_DCB=y
CONFIG_MAGIC_SYSRQ=y
CONFIG_MAGIC_SYSRQ_DEFAULT_ENABLE=0x0
# CONFIG_MAGIC_SYSRQ_SERIAL is not set
```

## kernel/files/Documentation/devicetree/bindings/clock/brcm,bcmring-chipc.yaml
```yaml
# SPDX-License-Identifier: (GPL-2.0-only OR BSD-2-Clause)
# Draft binding.  Passes dt_binding_check apart from the missing "maintainers" entry.
%YAML 1.2
---
$id: http://devicetree.org/schemas/clock/brcm,bcmring-chipc.yaml#
$schema: http://devicetree.org/meta-schemas/core.yaml#

title: Broadcom BCMRING chip-control clock and reset controller

description:
  The chip-control block of the BCM11107 family provides two PLLs, PLL
  channel and divider clocks, bus-interface clock gates, and soft resets.
  The same register block also holds straps, a few miscellaneous control
  registers, pin multiplexing, and pad control.  The clock driver registers
  the block's regmap as the syscon for this node, so other drivers can
  reference it by phandle; the generic "syscon" compatible must not be
  listed, because the regmap has to share the clock driver's lock.  Pin
  multiplexing is described by pinctrl-single child nodes.  Clock and reset
  IDs are in include/dt-bindings/clock/brcm,bcmring-chipc.h.

properties:
  compatible:
    const: brcm,bcmring-chipc

  reg:
    maxItems: 1

  clocks:
    items:
      - description: 25 MHz reference crystal

  clock-names:
    items:
      - const: xtal

  '#clock-cells':
    const: 1

  '#reset-cells':
    const: 1

  '#address-cells':
    const: 1

  '#size-cells':
    const: 1

  ranges: true

patternProperties:
  '^pinctrl@[0-9a-f]+$':
    type: object
    $ref: /schemas/pinctrl/pinctrl-single.yaml#
    description:
      LCD/PIF pad ownership (offset 0x114) and the per-pad 4-bit function
      fields (offset 0x118, eight registers, pads 0 to 60).

required:
  - compatible
  - reg
  - clocks
  - clock-names
  - '#clock-cells'
  - '#reset-cells'

additionalProperties: false

examples:
  - |
    clock-controller@80000000 {
        compatible = "brcm,bcmring-chipc";
        reg = <0x80000000 0x1000>;
        clocks = <&xtal>;
        clock-names = "xtal";
        #clock-cells = <1>;
        #reset-cells = <1>;
        #address-cells = <1>;
        #size-cells = <1>;
        ranges = <0 0x80000000 0x1000>;

        pinctrl@118 {
            compatible = "pinctrl-single";
            reg = <0x118 0x20>;
            #pinctrl-cells = <2>;
            pinctrl-single,register-width = <32>;
            pinctrl-single,function-mask = <0xf>;
            pinctrl-single,bit-per-mux;
        };
    };
```

## kernel/files/Documentation/devicetree/bindings/display/digium,gray-lcd.yaml
```yaml
# SPDX-License-Identifier: (GPL-2.0-only OR BSD-2-Clause)
%YAML 1.2
---
$id: http://devicetree.org/schemas/display/digium,gray-lcd.yaml#
$schema: http://devicetree.org/meta-schemas/core.yaml#

title: Digium D40/D45/D50/D70 grayscale SPI LCD assemblies

# SKETCH.  Not run through dt_binding_check.  The "digium" vendor prefix is
# not in vendor-prefixes.yaml and would have to be added.

description: |
  The Digium (later Sangoma) D40, D45, and D50 desk phones have one
  240x120 four-level grayscale LCD on an SPI bus.  The D70 has a 320x160
  panel of the same kind plus a 113x357 side display behind a second chip
  select.  On the D70 both panels share the data/command line, so they are
  described as one device with two chip selects.

  The controller ICs are not identified with certainty.  The main panels
  use a command set and pixel packing that match the Sitronix ST7586S; the
  side display's command set resembles the UltraChip UC16xx family.  The
  compatibles therefore name the assemblies, not controllers.

allOf:
  - $ref: /schemas/spi/spi-peripheral-props.yaml#
  - if:
      properties:
        compatible:
          const: digium,d70-lcd
    then:
      properties:
        reg:
          minItems: 2
        reset-gpios:
          minItems: 2
    else:
      properties:
        reg:
          maxItems: 1
        reset-gpios:
          maxItems: 1
        dss-backlight-enable-gpios: false
        dss-backlight-level-gpios: false

properties:
  compatible:
    enum:
      - digium,d40-lcd   # D40, D45, D50: 240x120 main panel
      - digium,d70-lcd   # D70: 320x160 main panel and 113x357 side display

  reg:
    minItems: 1
    items:
      - description: chip select of the main panel
      - description: chip select of the side display

  spi-max-frequency:
    maximum: 10000000

  dc-gpios:
    maxItems: 1
    description:
      Data/command select, high for pixel data and main-panel command
      parameters.  Shared by both panels on the D70.

  reset-gpios:
    minItems: 1
    items:
      - description: main panel reset
      - description: side display reset

  backlight:
    description: Backlight of the main panel.

  dss-backlight-enable-gpios:
    maxItems: 1
    description: Switches the side display backlight on.

  dss-backlight-level-gpios:
    minItems: 1
    maxItems: 8
    description:
      Binary-weighted brightness lines of the side display backlight, least
      significant bit first.

required:
  - compatible
  - reg
  - dc-gpios
  - reset-gpios

unevaluatedProperties: false

examples:
  - |
    #include <dt-bindings/gpio/gpio.h>

    spi {
        #address-cells = <1>;
        #size-cells = <0>;

        display@0 {
            compatible = "digium,d70-lcd";
            reg = <0>, <1>;
            spi-max-frequency = <10000000>;
            dc-gpios = <&gpio0 22 GPIO_ACTIVE_HIGH>;
            reset-gpios = <&gpio1 10 GPIO_ACTIVE_LOW>,
                          <&gpio1 1 GPIO_ACTIVE_LOW>;
            backlight = <&backlight>;
            dss-backlight-enable-gpios = <&gpio0 13 GPIO_ACTIVE_LOW>;
            dss-backlight-level-gpios = <&gpio0 8 GPIO_ACTIVE_LOW>,
                                        <&gpio0 26 GPIO_ACTIVE_LOW>,
                                        <&gpio0 27 GPIO_ACTIVE_LOW>,
                                        <&gpio0 28 GPIO_ACTIVE_LOW>,
                                        <&gpio0 29 GPIO_ACTIVE_LOW>;
        };
    };
...
```

## kernel/files/Documentation/devicetree/bindings/gpio/brcm,bcmring-gpio.yaml
```yaml
# SPDX-License-Identifier: (GPL-2.0-only OR BSD-2-Clause)
# Binding draft.  Passes dt_binding_check apart from the missing "maintainers" entry.
%YAML 1.2
---
$id: http://devicetree.org/schemas/gpio/brcm,bcmring-gpio.yaml#
$schema: http://devicetree.org/meta-schemas/core.yaml#

title: Broadcom BCMRING (BCM11107 family) GPIO bank

description:
  One 32-line GPIO bank with PL061-style interrupt registers at 0x404..0x41c
  and a plain 32-bit data register at offset 0.  The SoC has two banks,
  GPIO0 (lines 0..31) at 0x80004000 and GPIO1 (lines 32..60) at 0x80004800,
  each with one combined interrupt.  Pad multiplexing is a separate
  pinctrl-single node; reference it with gpio-ranges so that requesting a
  line selects the GPIO function.

properties:
  compatible:
    const: brcm,bcmring-gpio

  reg:
    maxItems: 1

  interrupts:
    maxItems: 1

  gpio-controller: true

  "#gpio-cells":
    const: 2

  ngpios:
    minimum: 1
    maximum: 32
    default: 32

  gpio-ranges: true

  interrupt-controller: true

  "#interrupt-cells":
    const: 2

required:
  - compatible
  - reg
  - interrupts
  - gpio-controller
  - "#gpio-cells"
  - interrupt-controller
  - "#interrupt-cells"

additionalProperties: false

examples:
  - |
    gpio@80004800 {
        compatible = "brcm,bcmring-gpio";
        reg = <0x80004800 0x800>;
        interrupts = <1>;
        gpio-controller;
        #gpio-cells = <2>;
        ngpios = <29>;
        gpio-ranges = <&pinmux 0 32 29>;
        interrupt-controller;
        #interrupt-cells = <2>;
    };
```

## kernel/files/Documentation/devicetree/bindings/input/brcm,bcmring-keypad.yaml
```yaml
# SPDX-License-Identifier: (GPL-2.0-only OR BSD-2-Clause)
%YAML 1.2
---
$id: http://devicetree.org/schemas/input/brcm,bcmring-keypad.yaml#
$schema: http://devicetree.org/meta-schemas/core.yaml#

title: Broadcom BCMRING (BCM11107 family) keypad matrix controller

description:
  Hardware-scanned, hardware-debounced key matrix controller ("KEYC") with
  up to 10 rows of 9 columns.  The row and column numbers of linux,keymap
  are the high and low nibble of the vendor scan code.  On the Digium
  boards column c is pad GPIO 43 + c and row r is pad GPIO 52 + r, both on
  mux function 1.

allOf:
  - $ref: /schemas/input/matrix-keymap.yaml#

properties:
  compatible:
    const: brcm,bcmring-keypad

  reg:
    maxItems: 1

  interrupts:
    maxItems: 1

  clocks:
    maxItems: 1
    description:
      Keypad bus-interface gate (chip control BusIntfClock bit 15).  Its
      rate (the bus clock rate) feeds the scan prescaler.

  keypad,num-rows:
    maximum: 10

  keypad,num-columns:
    maximum: 9

  debounce-delay-ms:
    description:
      Converted to the controller's 8-bit sample count at 9000 samples/s,
      so at most 28 ms.  The vendor value is 200 samples (about 22 ms),
      used when the property is absent.
    maximum: 28

  autorepeat: true

required:
  - compatible
  - reg
  - interrupts
  - clocks
  - keypad,num-rows
  - keypad,num-columns
  - linux,keymap

unevaluatedProperties: false

examples:
  - |
    #include <dt-bindings/input/input.h>
    keypad@8000d000 {
        compatible = "brcm,bcmring-keypad";
        reg = <0x8000d000 0x20>;
        interrupts = <16>;
        clocks = <&chipc 47>; /* BCMRING_CLK_BUSIF_LDK */
        keypad,num-rows = <7>;
        keypad,num-columns = <6>;
        linux,keymap = <MATRIX_KEY(4, 4, KEY_NUMERIC_1)
                        MATRIX_KEY(4, 3, KEY_NUMERIC_2)>;
    };
```
